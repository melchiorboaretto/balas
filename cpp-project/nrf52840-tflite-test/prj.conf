## CMakeLists.txt
```
cmake_minimum_required(VERSION 3.20.0)

find_package(Zephyr REQUIRED HINTS $ENV{ZEPHYR_BASE})
project(nrf52840_tflite_test LANGUAGES C CXX)

option(BALAS_NORDIC_ENABLE_MODEL "Build the BALAS TFLM profiling firmware" OFF)

target_include_directories(app PRIVATE
    include
)

target_sources(app PRIVATE
    src/serial_io.cpp
    src/timer.cpp
)

if(BALAS_NORDIC_ENABLE_MODEL)
    target_sources(app PRIVATE
        src/main_model.cpp
        Model/model.cpp
        Model/quantization.cpp
    )
    target_include_directories(app PRIVATE Model)
    target_compile_definitions(app PRIVATE BALAS_NORDIC_ENABLE_MODEL=1)
else()
    target_sources(app PRIVATE src/main_bringup.cpp)
endif()

target_compile_features(app PRIVATE cxx_std_17)
target_compile_options(app PRIVATE
    $<$<COMPILE_LANGUAGE:CXX>:-fno-exceptions>
    $<$<COMPILE_LANGUAGE:CXX>:-fno-rtti>
)
```

## prj.conf
```kconfig
CONFIG_GPIO=y
CONFIG_SERIAL=y
CONFIG_UART_INTERRUPT_DRIVEN=n

# The BALAS protocol owns UART0. Disable textual console/log output so no bytes
# can be mixed with the little-endian int32 inference response.
CONFIG_CONSOLE=n
CONFIG_UART_CONSOLE=n
CONFIG_PRINTK=n
CONFIG_LOG=n
CONFIG_BOOT_BANNER=n
CONFIG_NCS_BOOT_BANNER=n

CONFIG_CPP=y
CONFIG_STD_CPP17=y
CONFIG_MAIN_STACK_SIZE=4096
CONFIG_SYSTEM_WORKQUEUE_STACK_SIZE=1024
```

## model.conf
```kconfig
# Extra configuration loaded only for BALAS_NORDIC_ENABLE_MODEL=ON.
CONFIG_TENSORFLOW_LITE_MICRO=y
CONFIG_TENSORFLOW_LITE_MICRO_CMSIS_NN_KERNELS=y

# Input float32 buffer (12 KiB for the sanity fixture) is allocated with new.
CONFIG_HEAP_MEM_POOL_SIZE=24576
CONFIG_MAIN_STACK_SIZE=8192
```

## boards/nrf52840dk_nrf52840.overlay
```dts
&uart0 {
    status = "okay";
    current-speed = <115200>;
    hw-flow-control;
};
```

## include/serial_io.h
```c
#pragma once

#include <cstddef>
#include <cstdint>

bool serial_init();
void serial_read(uint8_t *dst, std::size_t n_bytes);
void serial_write(const uint8_t *src, std::size_t n_bytes);
```

## include/timer.h
```c
#pragma once

void start_timing();
int stop_timing();
```

## src/main_bringup.cpp
```c
#include <cstdint>

#include <zephyr/devicetree.h>
#include <zephyr/drivers/gpio.h>
#include <zephyr/kernel.h>

#include "serial_io.h"

namespace {
constexpr int32_t kBringupResponse = 52840;
const gpio_dt_spec status_led = GPIO_DT_SPEC_GET(DT_ALIAS(led0), gpios);

void signal_boot()
{
    if (!gpio_is_ready_dt(&status_led)) {
        return;
    }
    if (gpio_pin_configure_dt(&status_led, GPIO_OUTPUT_INACTIVE) != 0) {
        return;
    }
    for (int index = 0; index < 4; ++index) {
        gpio_pin_toggle_dt(&status_led);
        k_msleep(100);
    }
}
}

int main()
{
    signal_boot();
    if (!serial_init()) {
        return 1;
    }

    while (true) {
        uint8_t request[4];
        serial_read(request, sizeof(request));
        gpio_pin_toggle_dt(&status_led);
        serial_write(reinterpret_cast<const uint8_t *>(&kBringupResponse), sizeof(kBringupResponse));
    }
    return 0;
}
```

## src/main_model.cpp
```c
#include <cstdint>

#include <zephyr/devicetree.h>
#include <zephyr/drivers/gpio.h>

#include "input.h"
#include "model.h"
#include "output.h"
#include "serial_io.h"
#include "timer.h"

namespace {
const gpio_dt_spec status_led = GPIO_DT_SPEC_GET(DT_ALIAS(led0), gpios);
}

extern "C" {
volatile uint32_t balas_runtime_stage = 0;
}

int main()
{
    balas_runtime_stage = 1;
    if (!serial_init()) {
        balas_runtime_stage = 0xE001;
        return 1;
    }
    if (gpio_is_ready_dt(&status_led)) {
        gpio_pin_configure_dt(&status_led, GPIO_OUTPUT_INACTIVE);
    }

    balas_runtime_stage = 2;
    MyModel model;
    balas_runtime_stage = 3;
    ModelInput input(model.get_input_size());
    balas_runtime_stage = 4;
    ModelOutput output(model.get_output_size());
    balas_runtime_stage = 5;

    while (true) {
        serial_read(reinterpret_cast<uint8_t *>(input.data), input.size);
        balas_runtime_stage = 6;
        gpio_pin_toggle_dt(&status_led);
        start_timing();
        const bool inference_ok = model.run_inference(input, output);
        int32_t inference_time_us = inference_ok ? stop_timing() : -1;
        balas_runtime_stage = inference_ok ? 7 : 0xE007;
        serial_write(reinterpret_cast<const uint8_t *>(&inference_time_us), sizeof(inference_time_us));
    }
    return 0;
}
```

## src/serial_io.cpp
```c
#include "serial_io.h"

#include <zephyr/device.h>
#include <zephyr/devicetree.h>
#include <zephyr/drivers/uart.h>

namespace {
const device *const uart_device = DEVICE_DT_GET(DT_NODELABEL(uart0));
}

bool serial_init()
{
    return device_is_ready(uart_device);
}

void serial_read(uint8_t *dst, std::size_t n_bytes)
{
    std::size_t received = 0;
    while (received < n_bytes) {
        unsigned char value = 0;
        if (uart_poll_in(uart_device, &value) == 0) {
            dst[received++] = static_cast<uint8_t>(value);
        }
    }
}

void serial_write(const uint8_t *src, std::size_t n_bytes)
{
    for (std::size_t index = 0; index < n_bytes; ++index) {
        uart_poll_out(uart_device, src[index]);
    }
}
```

## src/timer.cpp
```c
#include "timer.h"

#include <cstdint>

#include <zephyr/kernel.h>

namespace {
uint32_t start_cycles = 0;
}

void start_timing()
{
    start_cycles = k_cycle_get_32();
}

int stop_timing()
{
    const uint32_t elapsed_cycles = k_cycle_get_32() - start_cycles;
    return static_cast<int>(k_cyc_to_us_floor32(elapsed_cycles));
}
```
